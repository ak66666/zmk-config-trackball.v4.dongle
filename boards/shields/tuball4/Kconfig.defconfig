## boards/shields/tuball4/Kconfig.defconfig
```kconfig
if SHIELD_TUBALL4_DONGLE || SHIELD_TUBALL4_LEFT || SHIELD_TUBALL4_RIGHT
config ZMK_SPLIT 
    default y
config ZMK_POINTING
    default y
endif

if SHIELD_TUBALL4_DONGLE
config ZMK_KEYBOARD_NAME
	default "Trackball v4"
config ZMK_SPLIT_ROLE_CENTRAL
	default y
endif

if SHIELD_TUBALL4_RIGHT
config SPI
    default y
endif
```

## boards/shields/tuball4/Kconfig.shield
```kconfig
# No whitespace after the comma or in your part name!

config SHIELD_TUBALL4_LEFT
    def_bool $(shields_list_contains,tuball4_left)

config SHIELD_TUBALL4_RIGHT
    def_bool $(shields_list_contains,tuball4_right)

config SHIELD_TUBALL4_DONGLE
	def_bool $(shields_list_contains,tuball4_dongle)
```
